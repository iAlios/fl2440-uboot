## board/samsung/fl2440/Kconfig
```kconfig
if TARGET_FL2440

config SYS_BOARD
	default "fl2440"

config SYS_VENDOR
	default "samsung"

config SYS_SOC
	default "s3c24x0"

config SYS_CONFIG_NAME
	default "fl2440"

endif
```

## configs/fl2440_defconfig
```kconfig
CONFIG_ARM=y
CONFIG_TARGET_FL2440=y
CONFIG_SYS_PROMPT="FL2440 # "
CONFIG_SUPPORT_SPL=y
CONFIG_SPL=y
```
